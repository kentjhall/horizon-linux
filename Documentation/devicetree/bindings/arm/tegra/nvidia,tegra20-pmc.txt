## Documentation/devicetree/bindings/phy/phy-max16984-cdp.txt
```
MAXIM MAX16984 CDP PHY binding
============================================

This binding describes a MAX16984 device that is used to provide CDP (charging
downstream port) support on Tegra USB host mode port, on Tegra platform.

Required properties (controller (parent) node):
- compatible : Should be "maxim,max16984-tegra186-cdp-phy" for tegra186 platforms,
               should be "maxim,max16984-tegra210-cdp-phy" for tegra210 platforms.
- #phy-cells : Should be 1

Optional properties (controller (parent) node) for tegra186 platforms:
- max,cdp-port0-cd0-gpio : GPIO phandle for UTMI port 0 CD0 pin
- max,cdp-port0-cd1-gpio : GPIO phandle for UTMI port 0 CD1 pin
- max,cdp-port1-cd0-gpio : GPIO phandle for UTMI port 1 CD0 pin
- max,cdp-port1-cd1-gpio : GPIO phandle for UTMI port 1 CD1 pin
- max,cdp-port2-cd0-gpio : GPIO phandle for UTMI port 2 CD0 pin
- max,cdp-port2-cd1-gpio : GPIO phandle for UTMI port 2 CD1 pin

Optional properties (controller (parent) node) for tegra210 platforms:
- max,cdp-port0-cd0-gpio : GPIO phandle for UTMI port 0 CD0 pin
- max,cdp-port0-cd1-gpio : GPIO phandle for UTMI port 0 CD1 pin
- max,cdp-port1-cd0-gpio : GPIO phandle for UTMI port 1 CD0 pin
- max,cdp-port1-cd1-gpio : GPIO phandle for UTMI port 1 CD1 pin
- max,cdp-port2-cd0-gpio : GPIO phandle for UTMI port 2 CD0 pin
- max,cdp-port2-cd1-gpio : GPIO phandle for UTMI port 2 CD1 pin
- max,cdp-port3-cd0-gpio : GPIO phandle for UTMI port 3 CD0 pin
- max,cdp-port3-cd1-gpio : GPIO phandle for UTMI port 3 CD1 pin

Note that CD1 pin are not used by now. CD0 gpio should be specified for a port
to actually provide the CDP function, or it's equivalent to no-op.

Example:

	tegra_ext_cdp: max16984-cdp {
		compatible = "maxim,max16984-tegra186-cdp-phy";
        #phy-cells = <1>;
        max,cdp-port0-cd0-gpio = <&tegra_gpio TEGRA_GPIO(J, 7) GPIO_ACTIVE_HIGH>;
        max,cdp-port2-cd0-gpio = <&tegra_gpio TEGRA_GPIO(K, 0) GPIO_ACTIVE_HIGH>;
	};

Specifying phy control of devices
=================================

USB host controller device nodes can specify this phy as "cdp-0", "cdp-1",
"cdp-2" or "cdp-3" PHYs for UTMI port 0, 1, 2 or 3.

Example:


	xhci@3530000 {
		...
		phys	  = ...
                    <&tegra_ext_cdp 0>,
                    <&tegra_ext_cdp 2>;
		phy-names = ...
                    "cdp-0", "cdp-2";
		...
	};
```

## Documentation/devicetree/bindings/platform/tegra/nvdumper/nvdumper.txt
```
NVDUMPER to capture copy of RAM following a crash
and helps analyze the failure

Required Properties:
 - compatible : Should be "nvidia,tegra210-nvdumper";

nvdumper {
        compatible = "nvidia,tegra210-nvdumper";
	status = "okay";
};
```

## Documentation/devicetree/bindings/power/gpio-battery.txt
```
Binding for GPIO Gas Gauge

Required properties:
 - compatible: "gpio-gas-gauge"
 - gpios: GPIO which will change value to signal when the power is low and
          the system should shutdown. This GPIO should include flags to
          specify if the GPIO is active low or not. In this case, active low
          would mean that the GPIO would go 0->1 when the power is low.

Optional properties:
 - supply-name: This is a string which can be passed through to use as the
                name of the power supply. It defaults to gpio-gas-gauge.

Example:

gpio-gas-gauge {
	compatible = "gpio-gas-gauge";
	gpios = <TEGRA_GPIO(D, 3) 0>;
	supply-name = "GPIO_gas_gage";
	status = "okay";
};
```

## Documentation/devicetree/bindings/power/supply/bq40z50_battery.txt
```
* BQ40Z50 fuel gauge devicetree bindings
~~~~~~~~~~

Required properties :
 - compatible : "ti,bq40z50-battery"
 - reg: I2C slave address

Required properties:
 - ti,design-capacity: battery capacity in mah
 - ti,design-voltage: battery charging terminate voltage in uV

Optional properties :
 - ti,btp-discharge-set: battery trip point set threshold for
   discharge mode for next btp interrupt
 - ti,btp-charge-set: btp set threshold for charge mode
   for next btp interrupt
 - ti,kernel-threshold-soc: kernel threshold soc value
   adjust battery soc value 0 to kernel threshold value
 - ti,kernel-maximum-soc: kernel maximum threshold soc value
   adjust battery soc value 100 to kernel max soc value
Example:

	bq40z50@0b {
		compatible = "ti,bq40z50-battery";
		reg = <0x0b>;
		ti,design-capacity = <7800>;
		ti,design-voltage = <4300000>;
		ti,kernel-threshold-soc = <2>;
		ti,kernel-maximum-soc = <98>;
	}
```

## Documentation/devicetree/bindings/power/supply/isl9238_charger.txt
```
* ISL9238 battery charger devicetree bindings

Required properties:
- compatible : "isil,isl9238"
- reg: I2C slave address

Required nodes:
- regulators: There must a regulator subnode for the following purposes:
               Enabling voltage supply to vbus port(to enable otg mode)

Optional properties:
- isl,charge-current-limit-ma: to set the charging current limit in ma

- isl,max-system-voltage-mv: to set the maximum charging voltage or
			 system regulating voltage

- isl,max-init-voltage-mv: to set the maximum init charging voltage or
			 system default regulating voltage

- isl,min-system-voltage-mv: to set the minimum system voltage

- isl,input-voltage-limit-mv: to set input voltage limit

- isl,adapter-current-limit1-ma: to se the adapter current limit 1

- isl,adapter-current-limit2-ma: to se the adapter current limit 2

- isl,acprochot-threshold: assertion threshold for adapter overcurrent
			   condition.

- isl,dcprochot-threshold: assertion threshold for adapter overcurrent
			   condition.

- isl,trickle-chg-current-ma: to configure trickle charging current

- isl,current-sense-res: current_sense_reister(rs1, rs2) to configure
			 charging current limit
			 charging current depends on sense resister value

- isl,adapter-sense-res: adapter_sense_reister(rs1, rs2) to configure
			 adapter current limit
			 adapter current depends on sense resister value

- isl,otg-voltage-mv: to set OTG mode output regulation voltage

- isl,otg-current-ma: to set OTG mode curret

- isl,disable-regulation: disable input volatge regulation, by default
			  input voltage regulation enabled

- isl,enable-bat-learn-mode: enable battery learn mode, by default
			    battery learn mode disabled

- isl,disable-turbo-mode: disable turbo mode, by default
			  turbo charging mode enabled

- isl,enable-auto-charging: enable auto charging mode

- isl,enable-battery-ovp: enables Battery OV (Overvoltage) fault protection
			by default battery ov fault disabled

- isl,enable-trigger-acok: enables trigger PROCHOT# with ACOK
			by default acok trigger disabled

- isl,enable-prochot-otg-current: enables trigger PROCHOT# with OTGCURRENT
			by default otgcurrent trigger disabled

- isl,disable-smbus-timer: disable smbus timer(safety timer)
			by default smbus timer enabled
			smbus timer used to ensure the SMBus master
			is active and to prevent overcharging the battery.

- isl,enable-psys-monitor: enables system power monitor PSYS function
			by default PSYS function is disabled

- isl,thermal-zone: thermal zone name to get battery temperature

- isl,temp-polling-time-sec: polling time to read battey temp and apply
		thermal profile

-isl,terminate-chg-current: terminate chagring current, if battery current
		below terminate charging current then disable charging.

- isl,temp-range: temperature range for thermal profile

- isl,current-voltage-table: current and voltage table for thermal profile
< 0C - No Charge
0C to 9C - 1.17A to 13.2V
10C to 19C - 1.95A to 13.2V
20C to 49C - 3.90A to 12.75V; then 1.95A 12.75V to 13.2V
50C to 59C - 1.95A to 12.3V
> 60C - No Charge

vbus regulator properties:
================
regulator-name: vbus regulator name.

charger regulator properties:
================
regulator-name: charger regulator name.

Example
bc_isl9238: isl9238@9 {
	compatible = "isil,isl9238";
	reg = <0x09>;
	isl,charge-current-limit = <4096000>;
	isl,max-system-voltage = <8192000>;
	isl,min-system-voltage = <1024000>;
	isl,input-voltage-limit = <2730000>;
	isl,enable-auto-charging;

	isl,thermal-zone = "battery";
	isl,temp-polling-time-sec = <5>;
	isl,terminate-chg-current = <78000>;
	isl,temp-range = <0 10 20 50 60>;
	isl,current-voltage-table = <0 780 1170 3900 1950
				     0 780 1170 1950 1950
				     0 13200 13200 12550 12300>;

	vbus {
		regulator-name = "otg-vbus-reg";
	};

	charger {
		regulator-name = "charger-vbus-reg";
	};
};
```

## Documentation/devicetree/bindings/pwm/nvidia,tegra-dfll-pwm.txt
```
Tegra SoC DFLL PWM controller

Required properties:
- compatible: For Tegra210, must contain "nvidia,tegra210-dfll-pwm".
- reg: physical base address and length of the controller's registers
- #pwm-cells: should be 2. See pwm.txt in this directory for a description of
  the cells format.
- clock-names: Must include the "ref" entry.
- clocks: Must contain one entry, for the DFLL closed loop reference clock.
  See ../clocks/clock-bindings.txt for details.
- pwm-regulator: phandle to PWM regulator for using this PWM controller.
- pinctrl-names: Must contain two entries to enable and disable PWM signals
  output pinmux states.
- pinctrl-0: pinmux state to enable PWM signals output
- pinctrl-1: pinmux state to disable PWM signals output

Example:

	pinmux: pinmux@700008d4 {
		dvfs_pwm_active_state: dvfs_pwm_active {
			dvfs_pwm_pbb1 {
				nvidia,pins = "dvfs_pwm_pbb1";
				nvidia,tristate = <TEGRA_PIN_DISABLE>;
			};
		};

		dvfs_pwm_inactive_state: dvfs_pwm_inactive {
			dvfs_pwm_pbb1 {
				nvidia,pins = "dvfs_pwm_pbb1";
				nvidia,tristate = <TEGRA_PIN_ENABLE>;
			};
		};
	};

	pwm_dfll: pwm@70110000 {
		compatible = "nvidia,tegra210-dfll-pwm";
		reg = <0x0 0x70110000 0x0 0x400>;
		clocks = <&tegra_car TEGRA210_CLK_DFLL_REF>;
		clock-names = "ref";
		#pwm-cells = <2>;
		pwm-regulator = <&cpu_ovr_reg>;

		pinctrl-names = "dvfs_pwm_enable", "dvfs_pwm_disable";
		pinctrl-0 = <&dvfs_pwm_active_state>;
		pinctrl-1 = <&dvfs_pwm_inactive_state>;

		status = "okay";
	};
```

## Documentation/devicetree/bindings/pwm/pwm-tegra-pmc-led-soft-blink.txt
```
NVIDIA Tegra PMC LED Soft Blink driver

Required properties:
- compatible: "nvidia,tegra210b01-pwm-led-soft-blink"
- #pwm-cells: should be 2. See pwm.txt in this directory for a description of
  the cells format.

Optional properties:
- pwm,led-breathing-ramp-time-ns: led breathing ramp up and ramp down time
- pwm,led-breathing-short-period-ns: led breathing short low period, breath out
	duration between two cones.

Example:

	tegra-pmc-blink-pwm {
		compatible = "nvidia,tegra210b01-pwm-led-soft-blink";
		pwm,led-breathing-ramp-time-ns = <240000000>;
		pwm,led-breathing-short-period-ns = <100000000>;
                #pwm-cells = <2>;
	};
```

## Documentation/devicetree/bindings/pwm/pwm-tegra-tachometer.txt
```
Tegra SoC Tachometer controller

Required properties:
- compatible: For Tegra186, must contain "nvidia,pwm-tegra186-tachometer".
- reg: physical base address and length of the controller's registers
- #pwm-cells: should be 2. See pwm.txt in this directory for a description of
  the cells format.
- clocks: Must contain one entry, for the module clock.
  See ../clocks/clock-bindings.txt for details.
  Must have the clock name as "tach".
- resets: Must contain an entry for each entry in reset-names.
  See ../reset/reset.txt for details.
- reset-names: Must include the following entries:
  - tach
- pulse-per-rev: Pulse per revolutions. This is based on the Fan property.
- capture-window-length: Window length for capturing PWM signal.


Optional properties:
- enable-dynamic-clock-gating: Enable dynamic clock gating. Once register read,
	clock is disabled.

Example:

	tachometer@39c0000 {
		compatible = "nvidia,pwm-tegra186-tachometer";
		reg = <0x0 0x039c0000 0x0 0x10>;
		clocks = <&tegra_car TEGRA186_CLK_TACH>;
		clock-names = "tach";
		resets = <&tegra_car TEGRA186_RESET_TACH>;
		reset-names = "tach";
		pulse-per-rev = <2>;
		capture-window-length = <2>;
		#pwm-cells = <2>;
	};
```

## Documentation/devicetree/bindings/regulator/max77812-regulator.txt
```
MAX77812 voltage regulator

Required properties:
- compatible: "maxim,max77812-regulator"
- reg: I2C slave address

Regulators subnode:

MAX77812 supports four regulators, regulators should be described under
    regualtors subnode.

Optional properties:
-maxim,ramp-up-slew-rate: to configure slew rate during regulator
	 voltage ramp up time
-maxim,ramp-down-slew-rate: to configre slew rate during regulator
	 voltage ramp down time
-maxim,soft-start-slew-rate: to configure slew rate during regulator
	enable time
-maxim,shutdown-slew-rate: to configure slew rate during regulator
	disable time or shutdown time

Each regulator is defined using the standard binding for regulators.

Example:

	max77812@1b {
		compatible = "maxim,max77812-regulator";
		reg = <0x1b>;

		regulators {
			m1vout {
				regulator-name = "mvout1";
				regulator-min-microvolt = <250000>;
				regulator-max-microvolt = <1525000>;
				regulator-boot-on;
				regulator-always-on;
				regulator-init-mode = <REGULATOR_MODE_NORMAL>;
			};

			m2vout {
				regulator-name = "mvout2";
				regulator-always-on;
				regulator-boot-on;
				regulator-min-microvolt = <250000>;
				regulator-max-microvolt = <1525000>;
				regulator-init-mode = <REGULATOR_MODE_NORMAL>;
			};
		};
	};
```
