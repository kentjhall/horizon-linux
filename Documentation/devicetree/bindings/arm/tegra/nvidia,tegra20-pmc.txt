## Documentation/devicetree/bindings/fuse/nvidia,tegra210-efuse-burn.txt
```
Tegra Fuse burn

Fuse burn driver to burn chip fuses when device is unlocked.

Required properties :
- compatible : Each chip has different spare reg offset and length.
  Must be one of these:
  - For Tegra186, "nvidia,tegra186-efuse-burn",
  - FOr Tegra194, "nvidia,tegra194-efuse-burn",
  - FOr Tegra210, "nvidia,tegra210-efuse-burn",
  - FOr Tegra210B01, "nvidia,tegra210b01-efuse-burn".
- clocks : Handle for "clk_m" clock.
- clock-names : is "clk_m".

Optional properties :
- nvidia,tz : Handle for thermal zone to get temperature values
- nvidia,temp-range : min and max temp range where fuse burn is allowed
- nvidia,redundant-aid-war : Some legacy kernel assume the AID fuse as
  redundant and read the fuse value in redundant way, from address X and
  address X+2, which should be address X and address X+1 instead. To align
  the platform we release with legacy kernel and client, add the
  "redundant-aid-war" for reading the same value as in the past. No longer
  needed in 4.14 and future kernels.
- thermal-zone : Adds shutdown limit check before burining fuse. should
  be either 5 for PLLX or 6 for AO.

Example:
	efuse@3820000 {
		compatible = "nvidia,tegra186-efuse";
		efuse-burn {
			compatible = "nvidia,tegra186-efuse-burn";
			clocks = <&tegra_car TEGRA186_CLK_CLK_M>;
			clock-names = "clk_m";
			nvidia,tz = <&aotag>;
			nvidia,temp-range = <4000 101000>;
		};
	};
```

## Documentation/devicetree/bindings/gpio/gpio-pca9570.txt
```
* NXP PCA953x I2C GPIO multiplexer

Required properties:
 - compatible: Has to contain one of the following:
	nxp,pca9570
- #gpio-cells : Should be two. The first cell is the pin number and the 
  second cell is used to specify optional parameters (currently unused).
- gpio-controller : Marks the device node as a GPIO controller.

Example:
	i2c@7000d000 {
		gpio@48 {
			compatible = "nxp,9570";
			reg = <0x48>;
			#gpio-cells = <2>;
			gpio-controller;
		};
	};
```

## Documentation/devicetree/bindings/hwmon/gpio-tachometer.txt
```
Device tree bindings for fan tach output connected to IRQ capable GPIO.

Required properties:
- compatible	: "nvidia,gpio-tachometer"
- win-len	: Duration in multiples of 100ms, for which the IRQ will be enabled
		  while measuring speed. Maximum allowed value is 5 seconds to avoid
		  possible IRQ overload at high speed.
- pulse-per-rev	: Number of signals generated on the tach output pin by the motor
		  for one full rotation.
- gpio		: GPIO pin on which tach output of the motor is connected.

Optional properties:
- schedule-delay: Time in milliseconds for the background thread to monitor the speed.
		  If the measured speed is 0, system shutdown will be initiated.
		  Time duration should be higher than win-len time.

Example:
        gpio_tachometer {
                compatible = "nvidia,gpio-tachometer";
                win-len = <2>;			/*For every measurement, take samples for 200ms*/
                pulse-per-rev = <2>;		/*Motor generates 2 pulses for every full rotation*/
                schedule-delay = <10000>;	/*Check motor speed every 10seconds and shutdown if motor is stopped*/
                gpio = <&tegra_main_gpio TEGRA_MAIN_GPIO(Y, 1) 0>;
                status = "okay";
        };
```

## Documentation/devicetree/bindings/leds/backlight/lp88xx.txt
```
lp88xx bindings

Required properties:
  - compatible: Should be one of "ti,lp8580", "ti,lp8863", "ti,lp8880"
  - reg: 0x2c for I2C slave address or SPI chip select address.
  - region-map: Region map code for LED 0 ~ LED5. Region map code is 0 to 5.
                In case of PWM mode, then only single region should be mapped.

Optional properties:
  - advanced-slope-enabled: Advanced slope effect.
  - enable-gpios: GPIO specifiers for HW enable pin.
  - irq-gpios: GPIO specifiers for fault interrupt pin.
  - pwms: PWM specifiers for backlight control.
  - slope-time-ms: Lighting effect. Slope time from 0 to 500.
  - names: Array of backlight driver name strings, in order, for each LED group.
  - max-input-brt: Maximum expected brightness value passed to the driver.
    This value is used to scale requested brightness values to the device's
    actual maximum brightness.
  - init-brt: Initial backlight brightness (applied to all LED groups). Must be
    scaled to max-input-brt, if provided, or otherwise max device brightness.

Example 1)
I2C for device configuration, map region 0 to all LEDs and PWM input for
backlight control.

	i2c1: i2c@f0018000 {
		backlight: lp8580@2c {
			compatible = "ti,lp8580";
			reg = <0x2c>;
			region-map = <0 0 0 0 0 0>;

			advanced-slope-enabled;
			enable-gpios = <&pioC 16 GPIO_ACTIVE_HIGH>;
			pwms = <&pwm0 0 10000 0>;
			slope-time-ms = <300>;
		};
	};

Example 2)
SPI for device configuration, CS is 0, backlight control through SPI,
interrupt handling, region 0 for LED 0, 1, 2, region 1 for LED 3, 4, 5.

	spi1: spi@f8008000 {
		cs-gpios = <&pioC 25 0>;
		status = "okay";

		backlight_spi: lp8880@0 {
			compatible = "ti,lp8880";
			spi-max-frequency = <8000000>;
			reg = <0>;

			region-map = <0 0 0 1 1 1>;
			slope-time-ms = <300>;
			advanced-slope-enabled;
			enable-gpios = <&pioC 16 GPIO_ACTIVE_HIGH>;
			irq-gpios = <&pioB 25 GPIO_ACTIVE_LOW>;
		};
	};
```

## Documentation/devicetree/bindings/leds/leds-thine350x.txt
```
* THine - THL3504/3502 24-Channel LED Driver

THL3504 - LED driver with 24 channel constant current sink outputs.
THL3502 - LED driver with 24 channel open drain outputs.
The controllers generate 256 step PWM that can be used to
control the brightness of LEDs. It supports LVDS I2C or SPI.
But the driver supports SPI based control which works without LVDS.

Required properties:
	- compatible:"thine350x"
	- reg:  SPI CS index
	- dev_address: Controller's internal address. Useful when multiple controllers are connected in series.
	- init_brightness: Initial brightness value to be set for the LEDs during boot.(Range 0 - 255)
Example:

leds: leds@6 {
	compatible = "thine350x";
	reg = <0>;
	dev_address = <0>;
	init_brightness = <255>;
}
```

## Documentation/devicetree/bindings/misc/gps_wake.txt
```
This driver is implemented to parse the gps_en gpio from device tree
and create a sysfs to control the gpio in gpsd binary. Also it
registers a irq to enable the HW geofencing feature.

SYSFS: This interface is used to toggle gps_en gpio in userspace.

Required Properties:
- compatible: Must be "gps-wake";
- gps-enable-gpio is resource name for gpio which power ON gps

Optional Properties:
- gps-wakeup-gpio is resource name for gps host wake irq line

Example:
gps_wake {
	compatible = "gps-wake";
	id = <0>;
	gps-enable-gpio = <&gpio_i2c_1_20 10 0>;
	gps-wakeup-gpio = <&gpio TEGRA_GPIO(Q, 5) 0>;
	status = "okay";
};
```

## Documentation/devicetree/bindings/mmc/sdhci-tegra.txt
```
* Nvidia sdhci-tegra controller

This file documents differences between the core properties in mmc.txt
and the properties used by the sdhci-tegra driver.

Required properties:
- compatible: Should be "nvidia,tegra210-sdhci"
- reg: Specify start address and registers count details
- interrupts: Specify the interrupts IRQ info for device
- id: Specify device id

Optional properties:
- built-in: Add the check if the device is built-in device
- bus-width: Specify device bus width details
- max-clk-limit: Specify the maximum clock limit for the device
- ddr-clk-limit: Specify the maximum clock frequency in kHz for device in DDR mode
- mmc-ocr-mask: Specify OCR register masking details
- uhs-mask: Specify modes that are masked for the device
	Mask HS200 mode: 0x20
	Mask HS400 mode: 0x40
	Mask SDR104 mode: 0x10
	Mask SDR50 mode: 0x4
	Mask DDR50 mode: 0x8
	Mask SDR25 mode: 0x2
- pll_source: Specify list of clock parents
- dqs-trim-delay: HS400 Tap value for incoming DQS path trimmer.
- cd-gpios: details of GPIO port used for SD card detect
- wp-gpios: details of GPIO port used for SD card write protect mode
- power-gpios: details of GPIO port used to power up SDIO card
- default-drv-type: Drive strength to select for SDIO devices is encoded as 8-bit char as follows
	Drive strength Type B: 0x0
	Drive strength Type A: 0x1
	Drive strength Type C: 0x2
	Drive strength Type D: 0x3
- disable-dynamic-clock-gating: flag when set disables sdmmc clock gating
- nvidia,disable-rtpm: Set this flag to disable runtime power management
  support for sdhci devices.
- power-off-rail: flag when set enables sdmmc reboot notifier
- pwrdet-support: flag when set indicates the sdmmc controller instance needs power detect bit programming for voltage switching.
- pwrdet-bit: Specify Tegra Power Management Controller power detect bit for the particular SDMMC controller instance. This field is specified only when the pwrdet-support is true
- nvidia,is-emmc: Enable this flag for eMMC devices
- nvidia,is-sdio: Enable this flag for SDIO devices
- nvidia,sd-device: Enable this flag for SD devices
- fixed-clock-freq: The first element is for ID mode. The rest of the entries are for different modes indexed as per ios timings.
	ID MODE			0
	MMC_TIMING_LEGACY	1
	MMC_TIMING_MMC_HS	2
	MMC_TIMING_SD_HS	3
	MMC_TIMING_UHS_SDR12	4
	MMC_TIMING_UHS_SDR25	5
	MMC_TIMING_UHS_SDR50	6
	MMC_TIMING_UHS_SDR104	7
	MMC_TIMING_UHS_DDR50	8
	MMC_TIMING_MMC_HS200	9
	MMC_TIMING_MMC_HS400	10
- nvidia,enable-hwcq: Set this flag to enable HW Command Queue support.
- nvidia,cd-wakeup-capable: Set this flag to enable card detect event as wake source.
- nvidia,enable-strobe-mode: Enable enhance strobe mode when eMMC device runs at HS400 mode.
- nvidia,en-periodic-calib: Enable periodic calibration support for sdmmc1/sdmmc3. Auto calibration sequence will be run at interval of 100ms during sdmmc1/sdmmc3 interfaces are active.
- nvidia,parent_clk_list: Defines the list of parent clock corresponding to the speed mode.
- nvidia,set-parent-clk: Use this flag, to select parent clock based on current speed mode, where parent-list available in DT.
- nvidia,en-periodic-cflush: Set this flag to enable periodic cache flushing
  to improve write performance without overhead of flushing cache with every
write.
- force-non-removable-rescan: Set this flag to force rescan for non-removable
  devices. Used for SDIO devices to allow re-init during wifi module
load/unload.
- only-1-8-v: Set this flag to specify that only 1.8V IO voltage is supported
  and same should be configured by default.
- nvidia,clk-en-before-freq-update: Set this flag to enable clock before
  updating clock frequency rate. This is needed for some SDMMC controller
instances.
-nvidia,min-tap-delay: Defines minimum tap delay in picoseconds seen on a SOC.
This value is SOC specific and used to compute lowerthreshold, upperthreshold, fixed_tap values needed for post auto-tuning correction algorithm.
-nvidia,max-tap-delay: Defines maximum tap delay in picoseconds seen on a SOC.
This value is SOC specific and used to compute lowerthreshold, upperthreshold, fixed_tap values needed for post auto-tuning correction algorithm.

Example:

	sdhci@700b0600 {
		compatible = "nvidia,tegra210-sdhci";
		reg = <0x0 0x700b0600 0x0 0x200>;
		interrupts = < 0 31 0x04 >;
		tap-delay = <4>;
		trim-delay = <3>;
		mmc-ocr-mask = <0>;
		max-clk-limit = <200000000>;
		uhs-mask = <0x20>; /* Mask HS200 */
		bus-width = <8>;
		id = <3>;
		pll_source = "pll_m", "pll_p";
		built-in;
		compad-vref-3v3 = <0x7>;
		compad-vref-1v8 = <0x7>;
		disable-dynamic-clock-gating;
		nvidia,runtime-pm-type = <1>;
		nvidia,en-periodic-cflush;
		nvidia,set-parent-clk;
		nvidia,enable-hwcq;
		nvidia,parent_clk_list = <"pll_p", "pll_c4_out0", "pll_p">;
		nvidia,min-tap-delay = <96>;
		nvidia,max-tap-delay = <139>;
		only-1-8-v;
		status = "okay";
		fixed-clock-freq = <25500000 25500000 24000000 47000000 24000000 47000000 94000000 204000000 0 0 0>;
	};

	sdhci@700b0000 {
		tap-delay = <0>;
		trim-delay = <2>;
		mmc-ocr-mask = <3>;
		max-clk-limit = <136000000>;
		ddr-clk-limit = <41000000>;
		uhs-mask = <0x8>;
		bus-width = <4>;
		id = <0>;
		pll_source = "pll_m", "pll_p";
		default-drive-type = <1>;
		force-non-removable-rescan;
		nvidia,min-tap-delay = <96>;
		nvidia,max-tap-delay = <139>;
		status = "okay";
	};
```
