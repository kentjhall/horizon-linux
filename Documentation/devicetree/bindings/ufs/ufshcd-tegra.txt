## drivers/clk/tegra/Kconfig
```kconfig
config TEGRA_CLK_EMC
	def_bool y
	depends on TEGRA124_EMC

config TEGRA_CLK_DEBUG
	def_bool y
	depends on DEBUG_FS
	---help---
	Enable debugfs entries to change clock parent/rate/state

config TEGRA_CLK_DFLL
	depends on (ARCH_TEGRA_124_SOC || ARCH_TEGRA_210_SOC)
	select PM_OPP
	def_bool y
```

## drivers/padctrl/Kconfig
```kconfig
menuconfig PADCTRL
	bool "Pad controller support"
	help
	  Say Y here to enable pad controller support

	  This framework provides a generic interface to PAD
	  devices.
```

## drivers/platform/Kconfig
```kconfig
if X86
source "drivers/platform/x86/Kconfig"
endif
if MIPS
source "drivers/platform/mips/Kconfig"
endif

source "drivers/platform/goldfish/Kconfig"

source "drivers/platform/chrome/Kconfig"

if ARCH_TEGRA
source "drivers/platform/tegra/Kconfig"
endif
```

## drivers/platform/tegra/Kconfig
```kconfig
# Copyright (c) 2012-2018, NVIDIA CORPORATION.  All rights reserved.
#
# This program is free software; you can redistribute it and/or modify it
# under the terms and conditions of the GNU General Public License,
# version 2, as published by the Free Software Foundation.
#
# This program is distributed in the hope it will be useful, but WITHOUT
# ANY WARRANTY; without even the implied warranty of MERCHANTABILITY or
# FITNESS FOR A PARTICULAR PURPOSE.  See the GNU General Public License for
# more details.
#
# You should have received a copy of the GNU General Public License
# along with this program.  If not, see <http://www.gnu.org/licenses/>.

comment "NVIDIA Tegra options"

config TEGRA_WAKEUP_MONITOR
	bool "Enable tegra wakeup monitor"
	depends on PM_SLEEP && ANDROID_INTF_ALARM_DEV
	help
	  This option enables support for the monitor of tegra wakeups, it will
	  send out wakeup source and uevents which indicate suspend_prepare and
	  post_suspend.

config TEGRA_POWERGATE
	bool "Tegra powergate support"
	default y
	help
	  Enable Tegra powergate support.

config NV_TEGRA_IVC
	bool "Tegra IVC protocol support (Downstream version)"
	default n
	help
	  Enable the Tegra IVC library, which implements a lockless, shared-
	  memory queue.

config TEGRA_HV_XHCI_DEBUG
	bool "Enable Tegra Hypervisor XHCI Server Debug"
	depends on TEGRA_HV_MANAGER
	default n
	help
	  Enable Tegra XHCI Server debugging when runs in virtualization.
```

## drivers/staging/stepper/Kconfig
```kconfig
config STEPPER
	tristate "Stepper Class Support"
	help
	  This option enables the stepper motor control sysfs class in /sys/class/stepper.
	  The sysfs class provides useful interfaces to control stepper motor.
	  If stepper motor is not used in the platform, select N.

config STEPPER_PCA
	tristate "NXP PCA Support"
	depends on STEPPER
	help
	  This option enables the NXP PCA control sysfs class in /sys/class/stepper.
	  It implements stepper class functions and communicates over I2C bus.
	  It should be enabled in the device tree under the right I2C bus.

comment "STEPPER drivers"
```

## drivers/usb/typec/Kconfig
```kconfig
menu "USB Power Delivery and Type-C drivers"

config TYPEC
	tristate

source "drivers/usb/typec/ucsi/Kconfig"

endmenu
```

## drivers/video/tegra/Kconfig
```kconfig
config TEGRA_DC
	tristate "Tegra Display Contoller"
	depends on (TEGRA_GRHOST || TEGRA_HOST1X) && I2C
	select BACKLIGHT_CLASS_DEVICE
	select FB_MODE_HELPERS
	help
	 Tegra display controller support.
	 Enable this to access the Tegra display controller using either framebuffer
	 console interface and a proprietary dc-ext interface or with ADF.
```

## kernel/horizon/Kconfig
```kconfig
# SPDX-License-Identifier: GPL-2.0

config HORIZON
	bool "Horizon Linux kernel"
	depends on ARM64
	depends on FUTEX
	depends on !TRANSPARENT_HUGEPAGE
	select CHECKPOINT_RESTORE
	select MEM_SOFT_DIRTY
	default y
```
